## application/samples/products/sle_uart/Kconfig
```kconfig
#===============================================================================
# @brief    Kconfig file.
# Copyright (c) @CompanyNameMagicTag 2023-2023. All rights reserved.
#===============================================================================

config SLE_UART_BUS
    int
    prompt "Set the UART BUS of the currrent sample."
    default 0
    depends on SAMPLE_SUPPORT_SLE_UART
    help
        This option means the UART BUS of the currrent sample.

config UART_TXD_PIN
    int
    prompt "Choose UART TXD pin."
    depends on SAMPLE_SUPPORT_SLE_UART
    default 17

config UART_RXD_PIN
    int
    prompt "Choose UART RXD pin."
    depends on SAMPLE_SUPPORT_SLE_UART
    default 18

choice
    prompt "Select sle uart type"
    default SAMPLE_SUPPORT_SLE_UART_SERVER
    config SAMPLE_SUPPORT_SLE_UART_SERVER
        bool "Enable SLE UART Server sample."
    config SAMPLE_SUPPORT_SLE_UART_CLIENT
        bool "Enable SLE UART Client sample."
endchoice


config SUPPORT_SLE_PERIPHERAL
    bool
    default y if (SAMPLE_SUPPORT_SLE_UART_SERVER)


config SUPPORT_SLE_CENTRAL
    bool
    default y if (SAMPLE_SUPPORT_SLE_UART_CLIENT)

config SLE_RL_LED_PIN
    int "Reliable-link on-board LED GPIO"
    default 2
    depends on SAMPLE_SUPPORT_SLE_UART_SERVER
    help
        GPIO2 drives the blue user LED on BearPi-Pico H3863.

config SLE_RL_LED_ACTIVE_LOW
    int "Reliable-link LED active-low flag (1: active low, 0: active high)"
    range 0 1
    default 0
    depends on SAMPLE_SUPPORT_SLE_UART_SERVER
    help
        BearPi-Pico H3863 lights the on-board blue LED with a high level
        (verified on hardware: GPIO2 high = on, low = off).
```
